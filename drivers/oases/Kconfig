## drivers/oases/Kconfig
```kconfig
#
# OASES device configuration
#

config OASES
	bool "OASES device"
	default n
	depends on ARM || ARM64
	help
	  Enable OASES

config OASES_SIGNATURE_SUPPORT
	bool "OASES patch signature verification"
	default n
	depends on OASES
	help
	  Enable OASES patch signature verification

config OASES_STATIC_PLTS
	bool "OASES static PLTs"
	default n
	depends on OASES
	help
	  Enable static PLT allocation
```
